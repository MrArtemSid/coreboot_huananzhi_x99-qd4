## autoport/Kconfig
```kconfig
## SPDX-License-Identifier: GPL-2.0-only

if BOARD_HUANANZHI_

config BOARD_SPECIFIC_OPTIONS
	def_bool y
	select AZALIA_USE_LEGACY_VERB_TABLE
	select BOARD_ROMSIZE_KB_16384
	select HAVE_ACPI_RESUME
	select HAVE_ACPI_TABLES
	select MEMORY_MAPPED_TPM
	select NORTHBRIDGE_INTEL_GRANTLEY
	select SERIRQ_CONTINUOUS_MODE
	select SOUTHBRIDGE_INTEL_LYNXPOINT
	select SUPERIO_NUVOTON_COMMON_PRE_RAM
	select SUPERIO_NUVOTON_NCT5539D

config MAINBOARD_DIR
	string
	default "huananzhi/"

config MAINBOARD_PART_NUMBER
	string
	default ""

config USBDEBUG_HCD_INDEX # FIXME: check this
	int
	default 2
endif
```
